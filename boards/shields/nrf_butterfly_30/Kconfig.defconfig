## boards/shields/nrf_butterfly_30/Kconfig.defconfig
```kconfig
if SHIELD_NRF_BUTTERFLY_30

config ZMK_KEYBOARD_NAME
    default "nrf butterfly30"

endif # SHIELD_NRF_BUTTERFLY_30
```

## boards/shields/nrf_butterfly_30/Kconfig.shield
```kconfig
config SHIELD_NRF_BUTTERFLY_30
    def_bool $(shields_list_contains,nrf_butterfly_30)
```

## boards/shields/xiao_butterfly_30/Kconfig.defconfig
```kconfig
if SHIELD_XIAO_BUTTERFLY_30

config ZMK_KEYBOARD_NAME
    default "butterfly30"

endif # SHIELD_XIAO_BUTTERFLY_30
```

## boards/shields/xiao_butterfly_30/Kconfig.shield
```kconfig
config SHIELD_XIAO_BUTTERFLY_30
    def_bool $(shields_list_contains,xiao_butterfly_30)
```

## boards/shields/xiao_split_60/Kconfig.defconfig
```kconfig
if SHIELD_XIAO_SPLIT_60_LEFT

config ZMK_KEYBOARD_NAME
    default "xiao split 60"

config ZMK_SPLIT_ROLE_CENTRAL
    default y

endif # SHIELD_XIAO_SPLIT_60_LEFT

if SHIELD_XIAO_SPLIT_60_LEFT || SHIELD_XIAO_SPLIT_60_RIGHT

config ZMK_SPLIT
    default y

endif # SHIELD_XIAO_SPLIT_60_LEFT || SHIELD_XIAO_SPLIT_60_RIGHT
```

## boards/shields/xiao_split_60/Kconfig.shield
```kconfig
config SHIELD_XIAO_SPLIT_60_LEFT
    def_bool $(shields_list_contains,xiao_split_60_left)

config SHIELD_XIAO_SPLIT_60_RIGHT
    def_bool $(shields_list_contains,xiao_split_60_right)
```
